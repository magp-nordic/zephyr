## boards/arm/nrf54l15pdk_nrf54l15/Kconfig.defconfig
```kconfig
# Copyright (c) 2024 Nordic Semiconductor ASA
# SPDX-License-Identifier: Apache-2.0

if BOARD_NRF54L15PDK_NRF54L15_CPUAPP

config BOARD
	default "nrf54l15pdk_nrf54l15_cpuapp"

config ENTROPY_GENERATOR
	default y if CRACEN

endif # BOARD_NRF54L15PDK_NRF54L15_CPUAPP

config BT_CTLR
	default BT

# MPU-based null-pointer dereferencing detection cannot
# be applied as the (0x0 - 0x400) is unmapped for this target.
choice NULL_POINTER_EXCEPTION_DETECTION
	bool
	default NULL_POINTER_EXCEPTION_DETECTION_NONE
endchoice
```

## boards/arm/nrf54l15pdk_nrf54l15/nrf54l15pdk_nrf54l15_cpuapp_defconfig
```kconfig
# Copyright (c) 2024 Nordic Semiconductor ASA
# SPDX-License-Identifier: Apache-2.0

CONFIG_SOC_SERIES_NRF54LX=y
CONFIG_SOC_NRF54L15_ENGA_CPUAPP=y
CONFIG_BOARD_NRF54L15PDK_NRF54L15_CPUAPP=y

# Enable MPU
CONFIG_ARM_MPU=y

# Enable hardware stack protection
CONFIG_HW_STACK_PROTECTION=y

# Enable Cache
CONFIG_CACHE_MANAGEMENT=y
CONFIG_EXTERNAL_CACHE=y

CONFIG_SYSTEM_CLOCK_WAIT=y

CONFIG_UART_CONSOLE=y
CONFIG_CONSOLE=y
CONFIG_SERIAL=y

CONFIG_PINCTRL=y

# Enable GPIO
CONFIG_GPIO=y

# Setup clocks
CONFIG_SOC_LFXO_CAP_INTERNAL=y
CONFIG_SOC_LFXO_CAP_INT_VALUE_X2=31
CONFIG_SOC_HFXO_CAP_INTERNAL=y
CONFIG_SOC_HFXO_CAP_INT_VALUE_X4=60

CONFIG_SOC_NRF_FORCE_CONSTLAT=y

# Start SYSCOUNTER on driver init
CONFIG_NRF_GRTC_START_SYSCOUNTER=y
```

## drivers/cache/Kconfig.nrfx
```kconfig
# Copyright (c) 2022 Carlo Caione <ccaione@baylibre.com>
# SPDX-License-Identifier: Apache-2.0

config CACHE_NRFX_CACHE
	bool "NRFX cache driver"
	select CACHE_HAS_DRIVER
	depends on SOC_SERIES_NRF54LX
	help
	  Enable support for the NRFX cache driver.
```

## dts/bindings/gpio/nordic,nrfe-gpio.yaml
```yaml
# Copyright (c) 2018, marc-cpdesign
# SPDX-License-Identifier: Apache-2.0

description: Emulated GPIO node

compatible: "nordic,nrfe-gpio"

include: [gpio-controller.yaml, base.yaml]

properties:

  "#gpio-cells":
    const: 2

  port:
    type: int
    required: true
    description: |
      The GPIO port number. GPIO port P0 has:

        port = <0>;

      And P1 has:

        port = <1>;

gpio-cells:
  - pin
  - flags
```

## dts/bindings/interrupt-controller/nordic,split-channels.yaml
```yaml
#
# Copyright (c) 2022 Nordic Semiconductor ASA
#
# SPDX-License-Identifier: Apache-2.0
#

description: Nordic Split Channels

properties:
    owned-channels:
      type: array
      required: true
      description: |
        List of channels in a split-ownership peripheral that are to be owned
        for use by the compiled CPU.

    nonsecure-channels:
      type: array
      description: |
        List of channels in a split-ownership, split-security peripheral that
        are to be configured as nonsecure. In Trustzone systems, this property
        is only evaluated for secure peripherals, as nonsecure channels are
        implicitly specified through the owned-channels property. This property
        is ignored in non-Trustzone systems.

    child-owned-channels:
      type: array
      description: |
        List of channels in a split-ownership peripheral that are officially
        owned by the compiled CPU but intended to be used by its child
        subprocessor(s).
```

## modules/hal_nordic/nrfe/Kconfig
```kconfig
# Copyright (c) 2024 Nordic Semiconductor ASA
# SPDX-License-Identifier: Apache-2.0

config HAS_NRFE
	bool

config NRFE
	bool "nRF Emulated Peripherals support"
	depends on HAS_NRFE
	help
	  This option enables the nRF Emulated Peripherals.
```

## soc/arm/nordic_nrf/nrf54l/Kconfig.defconfig.nrf54l15_enga_cpuapp
```kconfig
# Nordic Semiconductor nRF54L15 MCU

# Copyright (c) 2024 Nordic Semiconductor ASA
# SPDX-License-Identifier: Apache-2.0

if SOC_NRF54L15_ENGA_CPUAPP

config SOC
	string
	default "nRF54L15_CPUAPP"

config SOC_DOMAIN_NAME
	string
	default "application"

config NUM_IRQS
	int
	default 271

config IEEE802154_NRF5
	default IEEE802154

endif # SOC_NRF54L15_ENGA_CPUAPP
```

## soc/arm/nordic_nrf/nrf54l/Kconfig.defconfig.series
```kconfig
# Nordic Semiconductor nRF54L MCU line

# Copyright (c) 2024 Nordic Semiconductor ASA
# SPDX-License-Identifier: Apache-2.0

if SOC_SERIES_NRF54LX

rsource "Kconfig.defconfig.nrf54l*"

config SOC_SERIES
	default "nrf54l"

config CORTEX_M_SYSTICK
	default !NRF_GRTC_TIMER

config CACHE_NRFX_CACHE
	default y if EXTERNAL_CACHE

config SOC_NRF54LX_SKIP_CLOCK_CONFIG
	bool "Skip clock frequency configuration in system initialization"
	help
	  With this option, the CPU clock frequency is not set during system initialization.
	  The CPU runs with the default, hardware-selected frequency.

config SOC_NRF_FORCE_CONSTLAT
	bool "Force constant-latency mode"
	help
	  In constant latency mode the CPU wakeup latency and the PPI task response
	  will be constant and kept at a minimum. This is secured by forcing a set
	  of base resources on while in sleep. The advantage of having a constant
	  and predictable latency will be at the cost of having increased power consumption.

endif # SOC_SERIES_NRF54LX
```

## soc/arm/nordic_nrf/nrf54l/Kconfig.series
```kconfig
# Nordic Semiconductor nRF54L MCU line

# Copyright (c) 2024 Nordic Semiconductor ASA
# SPDX-License-Identifier: Apache-2.0

config SOC_SERIES_NRF54LX
	bool "Nordic Semiconductor nRF54L series MCU"
	select SOC_PLATFORM_NRF54L
	select HAS_NRFX
	select HAS_NORDIC_DRIVERS
	select HAS_SEGGER_RTT if ZEPHYR_SEGGER_MODULE
	select SOC_FAMILY_NRF
	help
	  Enable support for nRF54L MCU series

if SOC_SERIES_NRF54LX

config SOC_PLATFORM_NRF54L
	bool "Nordic Semiconductor nrf54l platform"
	select SOC_FAMILY_NRF
	help
	  Enable support for MCU series derived from the nrf54l platform.

endif # SOC_SERIES_NRF54LX
```

## soc/arm/nordic_nrf/nrf54l/Kconfig.soc
```kconfig
# Nordic Semiconductor nRF54 MCU line

# Copyright (c) 2024 Nordic Semiconductor ASA
# SPDX-License-Identifier: Apache-2.0

if SOC_SERIES_NRF54LX

config SOC_NRF54L15
	bool "NRF54L15"

config SOC_NRF54L15_ENGA
	select SOC_NRF54L15
	bool "NRF54L15 ENGA"

config SOC_NRF54L15_ENGA_CPUAPP
	select ARM
	select ARMV8_M_DSP
	select CPU_CORTEX_M33
	select CPU_HAS_ARM_MPU
	select CPU_HAS_ICACHE
	select CPU_HAS_ARM_SAU
	select CPU_HAS_FPU
	select HAS_HW_NRF_RADIO_IEEE802154
	select HAS_POWEROFF
	select SOC_NRF54L15_ENGA
	bool "NRF54L15 ENGA CPUAPP"

config SOC_NRF54L_VREG_MAIN_DCDC
	bool "Enable nRF54L DC/DC converter."
	help
	  To enable, an inductor must be connected to the DC/DC converter pin.

config SOC_NRF54L_NORMAL_VOLTAGE_MODE
	bool "Enable nRF54L Normal Voltage Mode."

config SOC_NRF54L_GLITCHDET_WORKAROUND
	bool "Enable workaround that disables glitch detector"
	default y
	help
	  Temporary workaround - disabling glitch detector to limit power consumption.

if NRF_GRTC_TIMER

config ELV_GRTC_LFXO_ALLOWED
	bool "Allow ELV mode when GRTC operates with LFXO source [EXPERIMENTAL]"
	depends on NRF_GRTC_SLEEP_ALLOWED
	select EXPERIMENTAL
	help
	  This featue allows using ELV mode when GRTC operates with the LFXO as
	  a low-frequency clock source. The LFXO is automatically activated when
	  preparing to system-off.
	  WARNING! This feature is EXPERIMENTAL and may brick your device!

endif # NRF_GRTC_TIMER

endif # SOC_SERIES_NRF54LX
```
